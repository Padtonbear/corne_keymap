## config/west.yml
```yaml
manifest:
  remotes:
    - name: zmkfirmware
      url-base: https://github.com/zmkfirmware
    - name: cormoran
      url-base: https://github.com/cormoran
  projects:
    - name: zmk
      remote: cormoran
      revision: main+custom-studio-protocol  # 👈 關鍵：改抓 cormoran 帶有自訂 RPC 協議與擴充 API 的 ZMK 分支
      import: app/west.yml
    - name: zmk-feature-runtime-combo
      remote: cormoran
      revision: main
    - name: zmk-feature-custom-settings
      remote: cormoran
      revision: main
  self:
    path: config
```
